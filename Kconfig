## Kconfig
```kconfig
# このリポジトリ独自のファームウェアのコードの設定（src/）

config SOSHO_CHARGING_LED
    bool "充電状態を状態表示の LED に出す"
    depends on RGBLED_WIDGET && ZMK_BATTERY_REPORTING && SOC_NRF52840
    # 緑の点灯に widget の「点滅のあとに戻す色」を使うので、レイヤーの色の表示とは同時に使えない
    depends on !RGBLED_WIDGET_SHOW_LAYER_COLORS
    # 充電中のフェードに使う（sosho.dtsi の &pwm1）
    select PWM
    help
      XIAO nRF52840 の充電 IC（BQ25101）の CHG 信号（P0.17）と USB 給電の有無を読み、
      zmk-rgbled-widget の LED に出す。充電中は黄のフェード（呼吸）、完了は緑の点灯（USB を抜くまで）、
      充電が止まったのに電池電圧が低いときは赤のフェード。src/charging_led.c

if SOSHO_CHARGING_LED

config SOSHO_CHARGING_LED_FADE_PERIOD_MS
    int "充電中・要確認のフェード 1 往復の時間 (ms)"
    range 200 20000
    default 3000
    help
      前半で明るくなり、後半で暗くなる

config SOSHO_CHARGING_LED_FADE_MIN_PCT
    int "フェードのいちばん暗いときの明るさ（見た目の %）"
    range 0 100
    default 20
    help
      0 にすると、いちばん暗いときに消える。見た目の明るさで指定する
      （LED に流す時間の割合はこの 2 乗。20 % なら 4 %）

config SOSHO_CHARGING_LED_YELLOW_RED_PCT
    int "黄を作るときの赤の強さ（緑に対する %）"
    range 0 100
    default 50
    help
      XIAO の緑の LED は抵抗が大きく暗い（赤 2.2 kΩ、緑 10 kΩ）。赤と緑を同じだけ点けるとオレンジに見えるので、
      赤を弱めて黄に寄せる。上げるとオレンジ寄りで明るく、下げると緑寄りで暗くなる

config SOSHO_CHARGING_LED_FULL_MV
    int "充電が止まったとき、完了とみなす電池電圧の下限 (mV)"
    default 4000
    help
      充電 IC は満充電のあと 4.1 V まで下がると継ぎ足すので、完了後の電圧は 4.1 V 以上に保たれる。
      測定の誤差を見込んで少し下に置く。これを下回ると「要確認」（10 時間の安全タイマーで止まったときなど）

endif
```

## config/west.yml
```yaml
# ZMK 本体と外部モジュールの版。どれも動作を確かめたコミットに固定している。
# 版を上げるときは、上げたいものの revision を main（またはタグ・新しいコミット）に書き換えて
# ./scripts/build-local.sh --update を実行し、ビルド・実機確認のあと、.zmk-ref/VERSIONS.txt に
# 記録されたコミットで固定し直す（手順は docs/workflow.html#zmk-update）。
# Zephyr の版は ZMK 本体の app/west.yml が決めるので、zmk を固定すれば一緒に固定される。
manifest:
  defaults:
    revision: main
  remotes:
    - name: zmkfirmware
      url-base: https://github.com/zmkfirmware
    - name: caksoylar
      url-base: https://github.com/caksoylar
    - name: badjeff
      url-base: https://github.com/badjeff
    - name: elekit-official
      url-base: https://github.com/elekit-official
  projects:
    - name: zmk
      remote: zmkfirmware
      revision: 4dd95d7840eb3d5a3f59bb29fbf1ab054715ef85  # main（2026-10-09）
      import: app/west.yml
    - name: zmk-rgbled-widget
      remote: caksoylar
      revision: e6b467792a1dabef8cfa5c9fd26bfefc9c16662b  # main（2026-07-09）
    - name: zmk-pmw3610-driver
      remote: badjeff
      revision: 44b4a76b74d293a93cec4ccb7e04cb8d29c10f93  # main（2026-04-16）
    - name: zmk_encoder
      remote: elekit-official
      revision: 1a34a5561f08eb7130823760fe597458f477e6db  # main（2026-06-25）
      path: modules/zmk_encoder
  self:
    path: config
```
